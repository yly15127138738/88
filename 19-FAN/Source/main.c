/*********************************************************************************************
* 文件：main.c
* 作者：Lixm 2017.10.17
* 说明：风扇实验 例程  
*       通过按键控制风扇开关，并将风扇的状态打印在PC上
* 修改：2017.11.08 chennian 将led、key文件替换为通用版驱动文件
*       2018.01.02 zhoucj   修改为串口一
* 注释： 
*********************************************************************************************/

/*********************************************************************************************
* 头文件
*********************************************************************************************/
#include <ioCC2530.h>
#include "clock.h"
#include "delay.h"
#include "fan.h"
#include "led.h"
#include "uart1.h"
#include "key.h"
#include "stdio.h"
#include "string.h"
#include "timer.h"

/*********************************************************************************************
* 名称：main()
* 功能：逻辑代码
* 参数：无
* 返回：无
* 修改：
* 注释：
*********************************************************************************************/
unsigned char fan_flag = 0;                                   //风扇状态标志位
int t;
void main(void)
{
  
  xtal_init();                                                  //系统时钟初始化     
  led_init();                                                   //LED初始化
  fan_init();                                                   //风扇初始化
  uart1_init(0x00,0x00);                                        //串口初始化
  key_init();                                                   //按键初始化
  time1_init();

  while(1)
  {
    if(K4 == DOWN)                                              //按键按下，改变2个LED灯状态
    {
      delay_ms(10);                                             //按键防抖
      if(K4 == DOWN)                                            //按键按下，改变2个LED灯状态
      {
        //while(K1 == DOWN);                                      //松手检测
        if(fan_flag == 0){                                      //检测之前的风扇状态
          fan_flag = 1;                                         //风扇状态标志位置1
          uart1_send_string("FAN ON,and timer start!\r\n");     //串口打印提示信息
          FAN = FAN_ON;                                         //开启风扇
        }
     }
      }
   }
}

#pragma vector=T1_VECTOR
__interrupt void T1_ISR(void)
{
  EA=0;
  t=t+1;
  if(T1STAT & 0x20)
  {
    if(t==26)
    {
      uart1_send_string("FAN OFF");
      FAN = FAN_OFF;
    }
  }
  EA=1;
}